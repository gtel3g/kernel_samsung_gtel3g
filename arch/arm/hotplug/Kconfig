## arch/arm/hotplug/Kconfig
```kconfig
config INTELLI_PLUG
 	bool "Hotplug for Razor Reborn"
 	depends on MSM_RUN_QUEUE_STATS
 	default y
 	help
 	  This enables kernel based multi core control.

config MSM_RUN_QUEUE_STATS
	bool "Enable collection and exporting of MSM Run Queue stats to userspace"
	default y
	help
	This option enables the driver to periodically collecting the statistics
	of kernel run queue information and calculate the load of the system.
	This information is exported to usespace via sysfs entries and userspace
	algorithms uses info and decide when to turn on/off the cpu cores.
```
